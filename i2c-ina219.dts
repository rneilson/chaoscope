/dts-v1/;
/plugin/;

/ {
  compatible = "brcm,bcm2835";

  fragment@0 {
    target = <&i2c_arm>;
    __overlay__ {
      #address-cells = <1>;
      #size-cells = <0>;

      ina219@40 {
        status = "okay";
        compatible = "ti,ina219";
        reg = <0x40>;
        shunt-resistor = <100000>;  // 100,000 uOhm, 0.1 Ohm
      };
    };
  };
};
